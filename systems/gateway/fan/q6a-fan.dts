// SPDX-License-Identifier: AGPL-3.0-only
/*
 * Radxa Dragon Q6A: Noctua NF-A8 5V PWM (4-pin) on the 40-pin header.
 *
 * Wiring. The fan runs from 5V; PWM and tach go straight to the header,
 * since GPIO24-27 pass through U48, a UM3204H open-drain-capable level
 * shifter (1V8 SoC side, 3V3 header side, 10k pull-ups on both sides).
 * The header-side pull-up also makes the fan run at full speed until this
 * driver takes over (Noctua: full speed without a PWM signal):
 *
 *   fan pin 1  GND (black)     -> header pin 6  (GND)
 *   fan pin 2  +5V (yellow)    -> header pin 4  (5V)
 *   fan pin 3  tach (green)    -> header pin 18 (GPIO27)
 *   fan pin 4  PWM (blue)      -> header pin 16 (GPIO26)
 *
 * U48's header side tolerates 6.5V as an input; while U48 drives it, the
 * limit is 3V3 + 0.5V. Noctua only says the fan pulls its PWM input up to
 * "3,3V/5V" internally (at most 5.25V open circuit, 5mA short circuit).
 * This fan's open-circuit PWM voltage has not been measured. In parallel
 * with U48's 10k pull-up to 3V3, the line idles between 3V3 and the fan's
 * own open-circuit level, so it stays within 3V3 + 0.5V only while that
 * level is at most 3.8V. Noctua's 5mA short-circuit limit
 * caps any current fed back into 3V3. A fan whose PWM input idles near 5V
 * needs a push-pull buffer instead, or pin 4 left unconnected (the fan
 * then runs at full speed). The tach is open collector (at most 5mA), so
 * U48's 10k pull-up to 3V3 is all it needs.
 *
 * None of the header pins can mux to a hardware PWM, so pwm-gpio drives
 * GPIO26 from an hrtimer: two timer interrupts per period whenever the fan
 * spins. pwm-fan never requests exactly 100% (255 maps to period - 1), so
 * only state 0 is free of timer interrupts.
 *
 * pwm-fan reads the tach and is bound as an active cooling device to the
 * sensors listed at the bottom; those zones have no other cooling maps and
 * are switched to step_wise by /etc/udev/rules.d/60-q6a-fan-thermal.rules.
 * step_wise raises the fan as soon as a trip is crossed, and lowers it one
 * state per falling reading once the temperature is back below a trip
 * minus FAN_HYST. Kernel 6.18.2 predates the step_wise fix "Fix stale
 * mitigation vote with non-zero lower bounds": a cool zone can keep voting
 * for a fan level until its own temperature next falls, so the fan may
 * slow down later than these trips suggest.
 *
 * Preprocessed with cpp, then merged into /boot/armbian-dtb-<kver> by
 * /usr/local/sbin/q6a-fan-dtb. Rerun that and reboot after editing.
 */

/* PWM period. 40000 ns = 25 kHz, the 4-pin fan spec. */
#define FAN_PERIOD_NS	40000

/* Trip temperatures (millicelsius) for fan states 1-5, see cooling-levels. */
#define FAN_TRIP1	55000
#define FAN_TRIP2	62000
#define FAN_TRIP3	69000
#define FAN_TRIP4	76000
#define FAN_TRIP5	83000
#define FAN_HYST	4000

#define FAN_TRIP(n, lbl, temp)						\
	lbl##_fan##n: q6a-fan-trip##n {					\
		temperature = <temp>;					\
		hysteresis = <FAN_HYST>;				\
		type = "active";					\
	};

#define FAN_MAP(n, lbl)							\
	q6a-fan-map##n {						\
		trip = <&lbl##_fan##n>;					\
		cooling-device = <&q6a_fan n n>;			\
	};

#define FAN_ZONE(lbl)							\
	lbl-thermal {							\
		polling-delay = <1000>;					\
		trips {							\
			FAN_TRIP(1, lbl, FAN_TRIP1)			\
			FAN_TRIP(2, lbl, FAN_TRIP2)			\
			FAN_TRIP(3, lbl, FAN_TRIP3)			\
			FAN_TRIP(4, lbl, FAN_TRIP4)			\
			FAN_TRIP(5, lbl, FAN_TRIP5)			\
		};							\
		cooling-maps {						\
			FAN_MAP(1, lbl)					\
			FAN_MAP(2, lbl)					\
			FAN_MAP(3, lbl)					\
			FAN_MAP(4, lbl)					\
			FAN_MAP(5, lbl)					\
		};							\
	};

/dts-v1/;
/plugin/;

&tlmm {
	q6a_fan_pwm_pins: q6a-fan-pwm-state {
		pins = "gpio26";
		function = "gpio";
		/* Sinks U48's pull-ups plus the fan's own PWM pull-up. */
		drive-strength = <8>;
		bias-disable;
	};

	q6a_fan_tach_pins: q6a-fan-tach-state {
		pins = "gpio27";
		function = "gpio";
		bias-disable;
	};
};

&{/} {
	q6a_fan_pwm: q6a-fan-pwm {
		compatible = "pwm-gpio";
		#pwm-cells = <3>;
		gpios = <&tlmm 26 0>;			/* GPIO_ACTIVE_HIGH */
		pinctrl-names = "default";
		pinctrl-0 = <&q6a_fan_pwm_pins>;
	};

	q6a_fan: q6a-fan {
		compatible = "pwm-fan";
		pwms = <&q6a_fan_pwm 0 FAN_PERIOD_NS 0>;
		/*
		 * Off, 25%, 40%, 60%, 80%, 100%. The NF-A8 stops at 0% and is
		 * only specified from 20% (400 rpm) to 100% (2200 rpm).
		 * No fan-stop-to-start-*: in 6.18 pwm-fan applies that kick to
		 * any change from a duty below it, not only from standstill.
		 */
		cooling-levels = <0 64 102 153 204 255>;
		#cooling-cells = <2>;
		interrupts-extended = <&tlmm 27 2>;	/* IRQ_TYPE_EDGE_FALLING */
		pulses-per-revolution = <2>;
		/*
		 * Full speed on shutdown/unbind; otherwise pwm-fan disables the
		 * PWM and pwm-gpio drives GPIO26 low, stopping the fan. A probe
		 * failure before this is parsed (e.g. the tach IRQ) still stops
		 * it; CPU passive throttling remains the backstop then. pwm-gpio
		 * has no shutdown hook, so "100%" keeps toggling 39999/1 ns; the
		 * 1 ns low is redone within the same timer IRQ, so a halted CPU
		 * leaves the pin high in practice. Not guaranteed on a bare
		 * halt; poweroff drops the 5V rail and reboot resets the pin.
		 */
		fan-shutdown-percent = <100>;
		pinctrl-names = "default";
		pinctrl-0 = <&q6a_fan_tach_pins>;
	};
};

&thermal_zones {
	FAN_ZONE(cpuss0)
	FAN_ZONE(cpuss1)
	FAN_ZONE(nspss0)
	FAN_ZONE(nspss1)
	FAN_ZONE(ddr)
};
